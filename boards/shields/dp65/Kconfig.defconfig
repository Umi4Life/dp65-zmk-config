## boards/shields/dp65/Kconfig.defconfig
```kconfig
if SHIELD_DP65_LEFT

config ZMK_KEYBOARD_NAME
    default "dp65"

config ZMK_SPLIT
    default y

config ZMK_SPLIT_ROLE_CENTRAL
    default y

endif # SHIELD_DP65_LEFT

if SHIELD_DP65_RIGHT

# TODO: enable BLE split — set ZMK_SPLIT default y, add col-offset <7> in
# dp65_right.overlay, merge to 65-key dp65.keymap, uncomment battery proxy in dp65.conf
config ZMK_SPLIT
    default n

endif # SHIELD_DP65_RIGHT
```

## boards/shields/dp65/Kconfig.shield
```kconfig
config SHIELD_DP65_LEFT
    def_bool $(shields_list_contains,dp65_left)

config SHIELD_DP65_RIGHT
    def_bool $(shields_list_contains,dp65_right)
```

## west.yml
```yaml
manifest:
  remotes:
    - name: zmkfirmware
      url-base: https://github.com/zmkfirmware
    - name: adolto
      url-base: https://github.com/adolto
  projects:
    - name: zmk
      remote: zmkfirmware
      revision: main
      import: app/west.yml
    - name: zmk-driver-ams-as5600
      remote: adolto
      revision: main
  self:
    path: .
```
